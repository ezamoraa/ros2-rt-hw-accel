## kr260/petalinux/project-spec/configs/rootfsconfigs/Kconfig.user
```kconfig
menu "user packages " 
config gpio-demo  
	 bool "gpio-demo"
	 help
	
config packagegroup-petalinux-kria  
	 bool "packagegroup-petalinux-kria"
	 help
	
config packagegroup-ros2-kria  
	 bool "packagegroup-ros2-kria"
	 help
	
config peekpoke  
	 bool "peekpoke"
	 help
	
endmenu
```
